## conf/layer.conf
```bitbake
# We have a conf and classes directory, add to BBPATH
BBPATH .= ":${LAYERDIR}"

# We have recipes-* directories, add to BBFILES
BBFILES += "${LAYERDIR}/recipes-*/*/*.bb \
            ${LAYERDIR}/recipes-*/*/*.bbappend"

BBFILE_COLLECTIONS += "meta-mainline"
BBFILE_PATTERN_meta-mainline = "^${LAYERDIR}/"
BBFILE_PRIORITY_meta-mainline = "6"

LAYERDEPENDS_meta-mainline = "core"
LAYERSERIES_COMPAT_meta-mainline = "scarthgap"

LICENSE_FLAGS_ACCEPTED += "synaptics-killswitch"
PREFERRED_PROVIDER_virtual/kernel = "linux-stable"
PREFERRED_VERSION_linux-stable = "6.16%"
```

## conf/machine/raspberrypi4-64-custom.conf
```bitbake
require conf/machine/raspberrypi4-64.conf

RPI_KERNEL_DEVICETREE = " \
    broadcom/bcm2711-rpi-4-b.dtb \
    broadcom/bcm2711-rpi-400.dtb \
    broadcom/bcm2711-rpi-cm4.dtb \
    broadcom/bcm2711-rpi-cm4s.dtb \
    broadcom/bcm2711-rpi-cm4-io.dtb \
"
RPI_KERNEL_DEVICETREE_OVERLAYS = ""

SERIAL_CONSOLES = "115200;ttyAMA0"
```
